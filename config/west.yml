## config/west.yml
```yaml
manifest:
  defaults:
    revision: ab46f48dde8aa70e44a2fc2d2a1b81ae703d4981
  remotes:
    - name: zmkfirmware
      url-base: https://github.com/zmkfirmware
    # Additional modules containing boards/shields/custom code can be listed here as well
    # See https://docs.zephyrproject.org/3.2.0/develop/west/manifest.html#projects
    - name: urob
      url-base: https://github.com/urob
  projects:
    - name: zmk
      remote: zmkfirmware
      import: app/west.yml
    - name: zmk-adaptive-key
      remote: urob
      revision: main
  self:
    path: config
```
